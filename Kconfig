## Kconfig
```kconfig
#
# For a description of the syntax of this configuration file,
# see Documentation/kbuild/kconfig-language.txt.
#
mainmenu "Linux/$ARCH $KERNELVERSION Kernel Configuration"

config SRCARCH
	string
	option env="SRCARCH"

source "arch/$SRCARCH/Kconfig"

# 
# 16 MAR 2014 Derick Beckwith
# Include the WFB scheduler in the build
#
config SCHED_WFB
	bool "WFB cpu scheduler"
	---help---
	  Brand new scheduler
```
